#include <Wire.h>
#include <Adafruit_GFX.h>
#include <Adafruit_SSD1306.h>
#include <WiFiS3.h>
#include <PubSubClient.h>

// ==================== WiFi & MQTT (Adafruit IO) 配置 ====================
const char* ssid          = "YOUR_WIFI_SSID";
const char* password      = "YOUR_WIFI_PASSWORD";
const char* mqtt_server   = "io.adafruit.com";
const int mqtt_port       = 1883;
const char* mqtt_user     = "YOUR_AIO_USERNAME";
const char* mqtt_pass     = "YOUR_AIO_KEY";

const char* topic_sensors = "hkz/feeds/sensors";
const char* topic_command = "hkz/feeds/command";

WiFiClient wifiClient;
PubSubClient mqttClient(wifiClient);

unsigned long lastMqttPublishTime = 0;
int currentDistance = 100;

// ==================== OLED 配置 ====================
#define SCREEN_I2C_ADDR 0x3C          // 根据你的实际地址修改（0x3C 或 0x3D）
#define SCREEN_WIDTH 128
#define SCREEN_HEIGHT 64
#define OLED_RST_PIN -1
Adafruit_SSD1306 display(SCREEN_WIDTH, SCREEN_HEIGHT, &Wire, OLED_RST_PIN);

// ==================== 传感器引脚 ====================
#define TRIG_PIN  9
#define ECHO_PIN  10
#define SOUND_PIN A0

// ==================== 动画参数 ====================
#define FRAME_DELAY  120      // 每帧显示时间（ms）
#define FRAME_WIDTH  128
#define FRAME_HEIGHT 64
#define FRAME_LIMIT  5       // 每套取前 5 帧（可改为 1 变静态）

// ==================== 帧数据占位（请替换为你自己的数据） ====================
// 说明：下面定义了 6 个数组，每个数组需要 FRAME_LIMIT 帧，每帧 512 字节。
// 请将你的 frames_calm, frames_happy, frames_sad, frames_smile, frames_unhappy
// 分别复制到对应的花括号中（覆盖掉占位的全 0 数据）。
// 注意：如果你没有专门的 "excited" 动画，可以用 frames_happy 代替。

// calm表情
// calm表情
// calm表情
// calm表情
// calm表情
// calm表情
const byte PROGMEM frames_calm[FRAME_LIMIT][1024] = {
  {
    0x00, 0x00, 0x00, 0x00, 0x00, 0x00, 0x00, 0x00,
    0x00, 0x00, 0x00, 0x00, 0x00, 0x00, 0x00, 0x00,
    0x00, 0x00, 0x00, 0x00, 0x00, 0x00, 0x00, 0x00,
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    0x00, 0x00, 0x00, 0x00, 0x00, 0x00, 0x00, 0x00
  },
  {
    0x00, 0x00, 0x00, 0x00, 0x00, 0x00, 0x00, 0x00,
    0x00, 0x00, 0x00, 0x00, 0x00, 0x00, 0x00, 0x00,
    0x00, 0x00, 0x00, 0x00, 0x00, 0x00, 0x00, 0x00,
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    0x00, 0x00, 0x00, 0x00, 0x00, 0x00, 0x00, 0x00
  },
  {
    0x00, 0x00, 0x00, 0x00, 0x00, 0x00, 0x00, 0x00,
    0x00, 0x00, 0x00, 0x00, 0x00, 0x00, 0x00, 0x00,
    0x00, 0x00, 0x00, 0x00, 0x00, 0x00, 0x00, 0x00,
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    0x00, 0x00, 0x00, 0x00, 0x00, 0x00, 0x00, 0x00
  },
  {
    0x00, 0x00, 0x00, 0x00, 0x00, 0x00, 0x00, 0x00,
    0x00, 0x00, 0x00, 0x00, 0x00, 0x00, 0x00, 0x00,
    0x00, 0x00, 0x00, 0x00, 0x00, 0x00, 0x00, 0x00,
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    0x00, 0x00, 0x00, 0x00, 0x00, 0x00, 0x00, 0x00
  },
  {
    0x00, 0x00, 0x00, 0x00, 0x00, 0x00, 0x00, 0x00,
    0x00, 0x00, 0x00, 0x00, 0x00, 0x00, 0x00, 0x00,
    0x00, 0x00, 0x00, 0x00, 0x00, 0x00, 0x00, 0x00,
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    0x00, 0x00, 0x00, 0x00, 0x00, 0x00, 0x00, 0x00
  }
};

// happy表情
const byte PROGMEM frames_happy[FRAME_LIMIT][1024] = {
  {
    0x00, 0x00, 0x00, 0x00, 0x00, 0x00, 0x00, 0x00,
    0x00, 0x00, 0x00, 0x00, 0x00, 0x00, 0x00, 0x00,
    0x00, 0x00, 0x00, 0x00, 0x00, 0x00, 0x00, 0x00,
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    0x00, 0x00, 0x00, 0x00, 0x00, 0x00, 0x00, 0x00
  },
  {
    0x00, 0x00, 0x00, 0x00, 0x00, 0x00, 0x00, 0x00,
    0x00, 0x00, 0x00, 0x00, 0x00, 0x00, 0x00, 0x00,
    0x00, 0x00, 0x00, 0x00, 0x00, 0x00, 0x00, 0x00,
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    0x00, 0x00, 0x00, 0x00, 0x00, 0x00, 0x00, 0x00
  },
  {
    0x00, 0x00, 0x00, 0x00, 0x00, 0x00, 0x00, 0x00,
    0x00, 0x00, 0x00, 0x00, 0x00, 0x00, 0x00, 0x00,
    0x00, 0x00, 0x00, 0x00, 0x00, 0x00, 0x00, 0x00,
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    0x00, 0x00, 0x00, 0x00, 0x00, 0x00, 0x00, 0x00
  },
  {
    0x00, 0x00, 0x00, 0x00, 0x00, 0x00, 0x00, 0x00,
    0x00, 0x00, 0x00, 0x00, 0x00, 0x00, 0x00, 0x00,
    0x00, 0x00, 0x00, 0x00, 0x00, 0x00, 0x00, 0x00,
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    0x00, 0x00, 0x00, 0x00, 0x00, 0x00, 0x00, 0x00
  },
  {
    0x00, 0x00, 0x00, 0x00, 0x00, 0x00, 0x00, 0x00,
    0x00, 0x00, 0x00, 0x00, 0x00, 0x00, 0x00, 0x00,
    0x00, 0x00, 0x00, 0x00, 0x00, 0x00, 0x00, 0x00,
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    0x00, 0x00, 0x00, 0x00, 0x00, 0x00, 0x00, 0x00
  }
};

// sad表情
const byte PROGMEM frames_sad[FRAME_LIMIT][1024] = {
  {
    0x00, 0x00, 0x00, 0x00, 0x00, 0x00, 0x00, 0x00,
    0x00, 0x00, 0x00, 0x00, 0x00, 0x00, 0x00, 0x00,
    0x00, 0x00, 0x00, 0x00, 0x00, 0x00, 0x00, 0x00,
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    0x00, 0x00, 0x00, 0x00, 0x00, 0x00, 0x00, 0x00
  },
  {
    0x00, 0x00, 0x00, 0x00, 0x00, 0x00, 0x00, 0x00,
    0x00, 0x00, 0x00, 0x00, 0x00, 0x00, 0x00, 0x00,
    0x00, 0x00, 0x00, 0x00, 0x00, 0x00, 0x00, 0x00,
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    0x00, 0x00, 0x00, 0x00, 0x00, 0x00, 0x00, 0x00
  },
  {
    0x00, 0x00, 0x00, 0x00, 0x00, 0x00, 0x00, 0x00,
    0x00, 0x00, 0x00, 0x00, 0x00, 0x00, 0x00, 0x00,
    0x00, 0x00, 0x00, 0x00, 0x00, 0x00, 0x00, 0x00,
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    0x00, 0x00, 0x00, 0x00, 0x00, 0x00, 0x00, 0x00
  },
  {
    0x00, 0x00, 0x00, 0x00, 0x00, 0x00, 0x00, 0x00,
    0x00, 0x00, 0x00, 0x00, 0x00, 0x00, 0x00, 0x00,
    0x00, 0x00, 0x00, 0x00, 0x00, 0x00, 0x00, 0x00,
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    0x00, 0x00, 0x00, 0x00, 0x00, 0x00, 0x00, 0x00
  },
  {
    0x00, 0x00, 0x00, 0x00, 0x00, 0x00, 0x00, 0x00,
    0x00, 0x00, 0x00, 0x00, 0x00, 0x00, 0x00, 0x00,
    0x00, 0x00, 0x00, 0x00, 0x00, 0x00, 0x00, 0x00,
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    0x00, 0x00, 0x00, 0x00, 0x00, 0x00, 0x00, 0x00
  }
};

// smile表情
const byte PROGMEM frames_smile[FRAME_LIMIT][1024] = {
  {
    0x00, 0x00, 0x00, 0x00, 0x00, 0x00, 0x00, 0x00,
    0x00, 0x00, 0x00, 0x00, 0x00, 0x00, 0x00, 0x00,
    0x00, 0x00, 0x00, 0x00, 0x00, 0x00, 0x00, 0x00,
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    0x00, 0x00, 0x00, 0x00, 0x00, 0x00, 0x00, 0x00
  },
  {
    0x00, 0x00, 0x00, 0x00, 0x00, 0x00, 0x00, 0x00,
    0x00, 0x00, 0x00, 0x00, 0x00, 0x00, 0x00, 0x00,
    0x00, 0x00, 0x00, 0x00, 0x00, 0x00, 0x00, 0x00,
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    0x00, 0x00, 0x00, 0x00, 0x00, 0x00, 0x00, 0x00
  },
  {
    0x00, 0x00, 0x00, 0x00, 0x00, 0x00, 0x00, 0x00,
    0x00, 0x00, 0x00, 0x00, 0x00, 0x00, 0x00, 0x00,
    0x00, 0x00, 0x00, 0x00, 0x00, 0x00, 0x00, 0x00,
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    0x00, 0x00, 0x00, 0x00, 0x00, 0x00, 0x00, 0x00
  },
  {
    0x00, 0x00, 0x00, 0x00, 0x00, 0x00, 0x00, 0x00,
    0x00, 0x00, 0x00, 0x00, 0x00, 0x00, 0x00, 0x00,
    0x00, 0x00, 0x00, 0x00, 0x00, 0x00, 0x00, 0x00,
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    0x00, 0x00, 0x00, 0x00, 0x00, 0x00, 0x00, 0x00
  },
  {
    0x00, 0x00, 0x00, 0x00, 0x00, 0x00, 0x00, 0x00,
    0x00, 0x00, 0x00, 0x00, 0x00, 0x00, 0x00, 0x00,
    0x00, 0x00, 0x00, 0x00, 0x00, 0x00, 0x00, 0x00,
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    0x00, 0x00, 0x00, 0x00, 0x00, 0x00, 0x00, 0x00
  }
};

// unhappy表情
const byte PROGMEM frames_unhappy[FRAME_LIMIT][1024] = {
  {
    0x00, 0x00, 0x00, 0x00, 0x00, 0x00, 0x00, 0x00,
    0x00, 0x00, 0x00, 0x00, 0x00, 0x00, 0x00, 0x00,
    0x00, 0x00, 0x00, 0x00, 0x00, 0x00, 0x00, 0x00,
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    0x00, 0x00, 0x00, 0x00, 0x00, 0x00, 0x00, 0x00
  },
  {
    0x00, 0x00, 0x00, 0x00, 0x00, 0x00, 0x00, 0x00,
    0x00, 0x00, 0x00, 0x00, 0x00, 0x00, 0x00, 0x00,
    0x00, 0x00, 0x00, 0x00, 0x00, 0x00, 0x00, 0x00,
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    0x00, 0x00, 0x00, 0x00, 0x00, 0x00, 0x00, 0x00
  },
  {
    0x00, 0x00, 0x00, 0x00, 0x00, 0x00, 0x00, 0x00,
    0x00, 0x00, 0x00, 0x00, 0x00, 0x00, 0x00, 0x00,
    0x00, 0x00, 0x00, 0x00, 0x00, 0x00, 0x00, 0x00,
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    0x00, 0x00, 0x00, 0x00, 0x00, 0x00, 0x00, 0x00
  },
  {
    0x00, 0x00, 0x00, 0x00, 0x00, 0x00, 0x00, 0x00,
    0x00, 0x00, 0x00, 0x00, 0x00, 0x00, 0x00, 0x00,
    0x00, 0x00, 0x00, 0x00, 0x00, 0x00, 0x00, 0x00,
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    0x00, 0x00, 0x00, 0x00, 0x00, 0x00, 0x00, 0x00
  },
  {
    0x00, 0x00, 0x00, 0x00, 0x00, 0x00, 0x00, 0x00,
    0x00, 0x00, 0x00, 0x00, 0x00, 0x00, 0x00, 0x00,
    0x00, 0x00, 0x00, 0x00, 0x00, 0x00, 0x00, 0x00,
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    0x00, 0x00, 0x00, 0x00, 0x00, 0x00, 0x00, 0x00
  }
};

// excited表情
const byte PROGMEM frames_excited[FRAME_LIMIT][1024] = {
  {
    0x00, 0x00, 0x00, 0x00, 0x00, 0x00, 0x00, 0x00,
    0x00, 0x00, 0x00, 0x00, 0x00, 0x00, 0x00, 0x00,
    0x00, 0x00, 0x00, 0x00, 0x00, 0x00, 0x00, 0x00,
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    0x00, 0x00, 0x00, 0x00, 0x00, 0x00, 0x00, 0x00
  },
  {
    0x00, 0x00, 0x00, 0x00, 0x00, 0x00, 0x00, 0x00,
    0x00, 0x00, 0x00, 0x00, 0x00, 0x00, 0x00, 0x00,
    0x00, 0x00, 0x00, 0x00, 0x00, 0x00, 0x00, 0x00,
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    0x00, 0x00, 0x00, 0x00, 0x00, 0x00, 0x00, 0x00
  },
  {
    0x00, 0x00, 0x00, 0x00, 0x00, 0x00, 0x00, 0x00,
    0x00, 0x00, 0x00, 0x00, 0x00, 0x00, 0x00, 0x00,
    0x00, 0x00, 0x00, 0x00, 0x00, 0x00, 0x00, 0x00,
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    0x00, 0x00, 0x00, 0x00, 0x00, 0x00, 0x00, 0x00
  },
  {
    0x00, 0x00, 0x00, 0x00, 0x00, 0x00, 0x00, 0x00,
    0x00, 0x00, 0x00, 0x00, 0x00, 0x00, 0x00, 0x00,
    0x00, 0x00, 0x00, 0x00, 0x00, 0x00, 0x00, 0x00,
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    0x00, 0x00, 0x00, 0x00, 0x00, 0x00, 0x00, 0x00
  },
  {
    0x00, 0x00, 0x00, 0x00, 0x00, 0x00, 0x00, 0x00,
    0x00, 0x00, 0x00, 0x00, 0x00, 0x00, 0x00, 0x00,
    0x00, 0x00, 0x00, 0x00, 0x00, 0x00, 0x00, 0x00,
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    0x00, 0x00, 0x00, 0x00, 0x00, 0x00, 0x00, 0x00
  }
};

// sleep表情
const byte PROGMEM frames_sleep[FRAME_LIMIT][1024] = {
  {
    0x00, 0x00, 0x00, 0x00, 0x00, 0x00, 0x00, 0x00,
    0x00, 0x00, 0x00, 0x00, 0x00, 0x00, 0x00, 0x00,
    0x00, 0x00, 0x00, 0x00, 0x00, 0x00, 0x00, 0x00,
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    0x00, 0x00, 0x00, 0x00, 0x00, 0x00, 0x00, 0x00
  },
  {
    0x00, 0x00, 0x00, 0x00, 0x00, 0x00, 0x00, 0x00,
    0x00, 0x00, 0x00, 0x00, 0x00, 0x00, 0x00, 0x00,
    0x00, 0x00, 0x00, 0x00, 0x00, 0x00, 0x00, 0x00,
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    0x00, 0x00, 0x00, 0x00, 0x00, 0x00, 0x00, 0x00
  },
  {
    0x00, 0x00, 0x00, 0x00, 0x00, 0x00, 0x00, 0x00,
    0x00, 0x00, 0x00, 0x00, 0x00, 0x00, 0x00, 0x00,
    0x00, 0x00, 0x00, 0x00, 0x00, 0x00, 0x00, 0x00,
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    0x00, 0x00, 0x00, 0x00, 0x00, 0x00, 0x00, 0x00
  },
  {
    0x00, 0x00, 0x00, 0x00, 0x00, 0x00, 0x00, 0x00,
    0x00, 0x00, 0x00, 0x00, 0x00, 0x00, 0x00, 0x00,
    0x00, 0x00, 0x00, 0x00, 0x00, 0x00, 0x00, 0x00,
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    0x00, 0x00, 0x00, 0x00, 0x00, 0x00, 0x00, 0x00
  },
  {
    0x00, 0x00, 0x00, 0x00, 0x00, 0x00, 0x00, 0x00,
    0x00, 0x00, 0x00, 0x00, 0x00, 0x00, 0x00, 0x00,
    0x00, 0x00, 0x00, 0x00, 0x00, 0x00, 0x00, 0x00,
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    0x00, 0x00, 0x00, 0x00, 0x00, 0x00, 0x00, 0x00
  }
};
// ==================== 情绪枚举 ====================
enum Mood {
  MOOD_CALM,
  MOOD_HAPPY,
  MOOD_SAD,
  MOOD_SMILE,
  MOOD_UNHAPPY,
  MOOD_EXCITED,
  MOOD_SLEEP
};

// ==================== 动画管理结构 ====================
struct Animation {
  const byte *frames; // 平坦一维指针，避开二维指针解引用的对齐与解密问题
  int frameCount;
  int frameDelay;
};

// 将 7 套动画按情绪索引排列
Animation anims[7] = {
  {(const byte *)frames_calm,    FRAME_LIMIT, FRAME_DELAY},   // MOOD_CALM
  {(const byte *)frames_happy,   FRAME_LIMIT, FRAME_DELAY},   // MOOD_HAPPY
  {(const byte *)frames_sad,     FRAME_LIMIT, FRAME_DELAY},   // MOOD_SAD
  {(const byte *)frames_smile,   FRAME_LIMIT, FRAME_DELAY},   // MOOD_SMILE
  {(const byte *)frames_unhappy, FRAME_LIMIT, FRAME_DELAY},   // MOOD_UNHAPPY
  {(const byte *)frames_excited, FRAME_LIMIT, FRAME_DELAY},   // MOOD_EXCITED
  {(const byte *)frames_sleep,   FRAME_LIMIT, FRAME_DELAY}    // MOOD_SLEEP
};

// ==================== 全局变量 ====================
Mood currentMood = MOOD_CALM;
int currentFrame = 0;
unsigned long lastFrameTime = 0;

// 传感器滤波
float smoothSound = 0;
int lastDistances[3] = {0,0,0};
int distIndex = 0;
unsigned long lastActiveTime = 0;
const unsigned long LONELY_TIMEOUT = 10000;   // 10秒无互动

// ---- 新增：情绪最短显示时间 与 过渡状态 ----
unsigned long moodChangeTime = 0;
const unsigned long MIN_DISPLAY_TIME = FRAME_LIMIT * FRAME_DELAY * 3;  // 至少显示3遍动画

bool inTransition = false;
unsigned long transitionStartTime = 0;
Mood nextMood = MOOD_CALM;

// 随机眨眼管理变量
bool isBlinking = false;
unsigned long blinkStartTime = 0;
unsigned long nextBlinkTime = 0;

// 稳态睡眠/打盹检测
unsigned long lastStateChangeTime = 0;
int prevDist = 100;
float prevSound = 0;

// 迟迟比较器状态
bool isNear = false;
bool isFar = false;

// ==================== 测距（中值滤波） ====================
int getDistance() {
  digitalWrite(TRIG_PIN, LOW);
  delayMicroseconds(2);
  digitalWrite(TRIG_PIN, HIGH);
  delayMicroseconds(10);
  digitalWrite(TRIG_PIN, LOW);
  long duration = pulseIn(ECHO_PIN, HIGH, 30000);
  if (duration == 0) {
    // 发生超时或未收到回波，返回上一次采样值，避免跳变到 999 破坏稳态检测
    return lastDistances[distIndex == 0 ? 2 : distIndex - 1];
  }
  int dist = duration / 58.2;
  if (dist > 400) dist = 400;
  lastDistances[distIndex] = dist;
  distIndex = (distIndex + 1) % 3;
  int a = lastDistances[0], b = lastDistances[1], c = lastDistances[2];
  int temp;
  if (a > b) { temp = a; a = b; b = temp; }
  if (b > c) { temp = b; b = c; c = temp; }
  if (a > b) { temp = a; a = b; b = temp; }
  return b;
}

// ==================== 声音传感器峰峰值采样（去除直流偏置） ====================
int getSoundIntensity() {
  unsigned long startMillis = millis();
  int maxVal = 0;
  int minVal = 1023;
  // 采样 15ms（覆盖 50Hz/60Hz 交流电网波形周期）
  while (millis() - startMillis < 15) {
    int val = analogRead(SOUND_PIN);
    if (val > maxVal) maxVal = val;
    if (val < minVal) minVal = val;
  }
  return maxVal - minVal;
}

// ==================== 情绪更新 ====================
void updateMood() {
  // 限制传感器物理采样频率为 20Hz (每 50ms 一次)
  static unsigned long lastSensorReadTime = 0;
  static int cachedDist = 100;
  static int cachedSound = 0;
  
  if (millis() - lastSensorReadTime >= 50 || lastSensorReadTime == 0) {
    lastSensorReadTime = millis();
    cachedDist = getDistance();
    currentDistance = cachedDist; // 更新全局变量，供 MQTT 无阻塞发送使用
    cachedSound = getSoundIntensity();
    smoothSound = smoothSound * 0.6 + cachedSound * 0.4;
  }
  
  int dist = cachedDist;
  
  // 1. 稳态与活动检测（用于维持唤醒状态，防止进入打盹，相对敏感）
  bool motionDetected = (abs(dist - prevDist) > 15 && dist < 200); // 距离变化大且在交互范围内
  bool soundDetected = (smoothSound > 120);                      // 声音中等响度以上

  if (motionDetected || soundDetected) {
    lastStateChangeTime = millis(); // 有活动，重置打盹计时器
    prevDist = dist;
    prevSound = smoothSound;
  }
  
  // 2. 深度打盹“惊醒”检测（打盹状态时，必须受到较大刺激才会唤醒）
  if (currentMood == MOOD_SLEEP && !inTransition) {
    bool wakeMotion = (abs(dist - prevDist) > 30 && dist < 120); // 必须在1.2米以内产生超过30cm的大幅度移动
    bool wakeSound = (smoothSound > 250);                      // 必须发出大于250的大声响（如拍手、大声呼唤）
    
    if (wakeMotion || wakeSound) {
      inTransition = true;
      transitionStartTime = millis();
      nextMood = MOOD_CALM;
      currentFrame = 4; // 闭眼起步
      drawCurrentFrame();
      lastActiveTime = millis();
      lastStateChangeTime = millis(); // 同步重置稳态计时
      prevDist = dist;
      prevSound = smoothSound;
      return;
    }
  }
  
  // 3. 如果稳定无活动达到 15 秒，自动进入打盹 (睡眠) 状态
  if (millis() - lastStateChangeTime >= 15000 && !inTransition && currentMood != MOOD_SLEEP) {
    inTransition = true;
    transitionStartTime = millis();
    nextMood = MOOD_SLEEP;
    currentFrame = 4; // 闭眼过渡到打盹
    drawCurrentFrame();
    return;
  }
  
  // 如果处于睡眠模式，且没有触发惊醒，则不执行常规情绪计算
  if (currentMood == MOOD_SLEEP) return;

  const int LOUD = 250, QUIET = 30; // 调整为峰峰值对应的噪声阈值

  // 迟滞比较器 (Hysteresis) 消除边界抖动
  if (dist < 40) {
    isNear = true;
    isFar = false;
  } else if (dist > 50) {
    isNear = false;
  }

  if (dist > 85) {
    isFar = true;
    isNear = false;
  } else if (dist < 75) {
    isFar = false;
  }
  
  bool interacting = false;
  Mood targetMood = currentMood;      // 默认不变
  
  if (isNear) {
    interacting = true;
    if (smoothSound > LOUD) targetMood = MOOD_EXCITED;
    else targetMood = MOOD_HAPPY;
  }
  else if (isFar) {
    if (smoothSound > QUIET) {
      interacting = true;
      targetMood = MOOD_CALM;
    } else {
      targetMood = MOOD_SAD; // 距离大于 80cm 且无声音输入，稳定触发伤心
    }
  }
  else {
    if (smoothSound > QUIET) {
      interacting = true;
      targetMood = MOOD_SMILE;
    } else {
      targetMood = MOOD_CALM;
    }
  }
  
  if (interacting) lastActiveTime = millis();
  
  // 超时强制伤心
  if ((millis() - lastActiveTime > LONELY_TIMEOUT) && (smoothSound < QUIET)) {
    targetMood = MOOD_SAD;
  }
  
  // ------- 核心：只有超过最短显示时间才切换，并触发过渡 -------
  if (targetMood != currentMood && !inTransition) {
    unsigned long now = millis();
    if (now - moodChangeTime >= MIN_DISPLAY_TIME) {
      inTransition = true;
      transitionStartTime = now;
      nextMood = targetMood;
      currentFrame = 4;           // 强制设为当前情绪的第4帧（即眨眼/闭眼帧）
      drawCurrentFrame();         // 立即重绘闭眼，开始过渡
    }
  }
  
  // 调试信息
  Serial.print("Dist: "); Serial.print(dist);
  Serial.print(" Sound: "); Serial.print(smoothSound);
  Serial.print(" Curr: "); Serial.print(currentMood);
  Serial.print(" Target: "); Serial.println(targetMood);
}

// ==================== 绘制当前帧 ====================
void drawCurrentFrame() {
  display.clearDisplay();
  // 一维扁平数组中做偏移计算，每帧 1024 字节 (128x64 像素)
  const byte *framePtr = anims[currentMood].frames + (currentFrame * 1024);
  // 表情占满 128x64 屏幕，绘图起点为 (0, 0)
  display.drawBitmap(0, 0, framePtr, FRAME_WIDTH, FRAME_HEIGHT, 1);
  display.display();
}

// ==================== MQTT 消息接收回调 ====================
void mqttCallback(char* topic, byte* payload, unsigned int length) {
  String message = "";
  for (unsigned int i = 0; i < length; i++) {
    message += (char)payload[i];
  }
  Serial.print("MQTT message arrived: ");
  Serial.println(message);
  
  // 解析 JSON 格式指令，如 {"val": 1}
  int valIndex = message.indexOf("\"val\":");
  if (valIndex >= 0) {
    int targetMoodVal = message.substring(valIndex + 6, message.indexOf("}", valIndex)).toInt();
    if (targetMoodVal >= 0 && targetMoodVal <= 6) {
      // 触发表情同步切换（包含过渡动效）
      if (currentMood != (Mood)targetMoodVal && !inTransition) {
        inTransition = true;
        transitionStartTime = millis();
        nextMood = (Mood)targetMoodVal;
        currentFrame = 4; // 闭眼起步过渡
        drawCurrentFrame();
        lastActiveTime = millis();
        lastStateChangeTime = millis();
      }
    }
  }
}

// ==================== 保持 MQTT 连接并鉴权 ====================
void reconnectMqtt() {
  while (!mqttClient.connected()) {
    Serial.print("Connecting to Adafruit IO...");
    String clientId = "ArduinoClient-" + String(random(0, 9999));
    
    // 连接时传入用户名和 AIO Active Key 作为密码鉴权
    if (mqttClient.connect(clientId.c_str(), mqtt_user, mqtt_pass)) {
      Serial.println("connected!");
      mqttClient.subscribe(topic_command); // 成功连接后重新订阅指令 Feed
    } else {
      Serial.print("failed, rc=");
      Serial.print(mqttClient.state());
      Serial.println(" try again in 5 seconds");
      delay(5000);
    }
  }
}

// ==================== setup ====================
void setup() {
  Serial.begin(115200);
  
  pinMode(TRIG_PIN, OUTPUT);
  pinMode(ECHO_PIN, INPUT);
  
  if(!display.begin(SSD1306_SWITCHCAPVCC, SCREEN_I2C_ADDR)) {
    Serial.println(F("SSD1306 allocation failed"));
    for(;;);
  }
  Wire.setClock(100000); // 强行将 I2C 时钟降回 100kHz，尝试修复新版 R4 Core 1.5.2 在默认 400kHz 下的 I2C 时序 Bug
  display.clearDisplay();
  display.display();
  
  // 连接手机热点 WiFi
  Serial.print("Connecting to WiFi: ");
  Serial.println(ssid);
  WiFi.begin(ssid, password);
  while (WiFi.status() != WL_CONNECTED) {
    delay(500);
    Serial.print(".");
  }
  Serial.println("\nWiFi connected!");
  
  // 设置 MQTT 服务器及消息回调函数
  mqttClient.setServer(mqtt_server, mqtt_port);
  mqttClient.setCallback(mqttCallback);
  
  delay(500);
  
  smoothSound = getSoundIntensity(); // 初始化声音采样
  for (int i = 0; i < 3; i++) lastDistances[i] = getDistance();
  lastActiveTime = millis();
  lastStateChangeTime = millis(); // 初始化稳态计时器
  
  // ---- 初始化情绪时间戳，使第一次切换立即生效 ----
  moodChangeTime = millis() - MIN_DISPLAY_TIME;
  nextBlinkTime = millis() + random(3000, 8000); // 3-8秒后第一次眨眼
}

// ==================== loop ====================
void loop() {
  // 确保 WiFi 保持在线
  if (WiFi.status() != WL_CONNECTED) {
    WiFi.begin(ssid, password);
    while (WiFi.status() != WL_CONNECTED) {
      delay(500);
    }
  }
  
  // 确保 MQTT 保持在线
  if (!mqttClient.connected()) {
    reconnectMqtt();
  }
  mqttClient.loop(); // 保持监听订阅事件
  
  updateMood();   // 更新情绪（含切换控制）
  
  unsigned long now = millis();
  
  // 每 3000ms (符合 Adafruit IO 的限频政策，避免频繁发送导致断连) 上报一次传感器数据到 Feed
  if (now - lastMqttPublishTime >= 3000) {
    lastMqttPublishTime = now;
    
    // 使用全局变量 currentDistance，避免重复调用 getDistance() 导致 pulseIn 阻塞 CPU
    int dist = currentDistance;
    
    // 拼接 JSON 格式数据发送
    String json = "{\"distance\":" + String(dist) + 
                  ",\"sound\":" + String((int)smoothSound) + 
                  ",\"mood\":" + String((int)currentMood) + "}";
                  
    mqttClient.publish(topic_sensors, json.c_str());
  }
  
  if (inTransition) {
    // 闭眼过渡维持 200 毫秒，然后切换状态并睁眼
    if (now - transitionStartTime >= 200) {
      currentMood = nextMood;
      moodChangeTime = now;
      currentFrame = 0;           // 新表情从第 0 帧（睁眼）开始播放
      inTransition = false;
      isBlinking = false;         // 退出眨眼状态
      nextBlinkTime = now + random(3000, 8000); // 重新计算下一次眨眼时间
      drawCurrentFrame();
    }
  } 
  else if (isBlinking) {
    // 随机闭眼持续 150 毫秒后睁眼
    if (now - blinkStartTime >= 150) {
      isBlinking = false;
      currentFrame = 0; // 回到第 0 帧睁眼状态
      nextBlinkTime = now + random(3000, 8000); // 3-8秒后再次随机眨眼
      drawCurrentFrame();
    }
  }
  else {
    // 检查是否触发随机眨眼（仅在非打盹模式下）
    if (currentMood != MOOD_SLEEP && now >= nextBlinkTime) {
      isBlinking = true;
      blinkStartTime = now;
      currentFrame = 4; // 强制设为闭眼帧
      drawCurrentFrame();
    } 
    // 正常动画播放
    else if (now - lastFrameTime >= anims[currentMood].frameDelay) {
      lastFrameTime = now;
      currentFrame++;
      // 打盹模式循环所有 5 帧以播放完整的 Zzz 动画；其他情绪只循环前 4 帧（避开第 4 帧闭眼）
      int maxFrames = (currentMood == MOOD_SLEEP) ? anims[currentMood].frameCount : 4;
      if (currentFrame >= maxFrames) currentFrame = 0;
      drawCurrentFrame();
    }
  }
  
  delay(10);
}